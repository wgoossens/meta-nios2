## conf/layer.conf
```bitbake
# We have a conf and classes directory, append to BBPATH
BBPATH .= ":${LAYERDIR}"

BBFILES += "${LAYERDIR}/classes/*.bb*"
BBFILES += "${LAYERDIR}/recipes-*/*/*.bb*"

BBFILE_COLLECTIONS += "META_NIOS2"
BBFILE_PATTERN_META_NIOS2 := "^${LAYERDIR}/"
BBFILE_PRIORITY_META_NIOS2 = "15"

BBMASK = "/linux-dummy"
```

## conf/machine/ghrd3c120.conf
```bitbake
#@TYPE: Machine
#@Name: 3c120 GHRD example machine
#@DESCRIPTION: Machine configuration for nios2 machines

require conf/machine/include/tune-nios2.inc

TUNE_ARCH = "nios2"
TARGET_FPU = "soft"

#Use sopcinfo and boardinfo file from metadata
SOPCINFO_DIR :="${@os.path.dirname(d.getVar('FILE',True))}/sopcinfo/ghrd3c120"
SOPCINFO_FILE  := "${SOPCINFO_DIR}/qsys_ghrd_3c120.sopcinfo"
BOARDINFO_FILE := "${SOPCINFO_DIR}/3c120_boardinfo.xml"

MACHINE_FEATURES = "kernel26 serial"

KERNEL_IMAGETYPE = "zImage"

JFFS2_ERASEBLOCK = "0x20000"
```

## conf/machine/include/nios2/arch-nios2.inc
```bitbake
#@TYPE: Machine configuration
#@NAME: nios2
#@DESCRIPTION: generic machine configuration for nios2 with mmu 

DEFAULT_TUNE ?= "nios2"
TUNE_PKGARCH = "${TUNE_PKGARCH_tune-${DEFAULTTUNE}}"
ABIEXTENSION ?= ""

TUNEVALID[fpu-custom] = "Use custom-instruction FPU"

AVAILTUNE += "nios2"
TUNE_FEATURES_tune-nios2 = "fpu-custom"
TUNE_PKGARCH_tune-nios2 = "nios2"
PACKAGE_EXTRA_ARCHS_tune-nios2 = "nios2"

# Set default for common nios2-based machines
MACHINE_FEATURES ?= "kernel26"
# Select an appropriate default kernel

PREFERRED_PROVIDER_virtual/kernel ?= "linux-nios2"

#-------------------------------------------------------------------------------
# Board defaults
#-------------------------------------------------------------------------------
# These values are board specific but they seem to be common to a large number
# of boards so are reasonable defaults.
USE_VT = "0"
UBOOT_MACHINE ?= "nios2-custom"
```

## conf/machine/include/nios2/feature-nios2-fpu.inc
```bitbake
TARGET_FPU = "fpu-other"

TUNEVALID[fpu-soft] = "Use Nios2 software FPU"
TUNEVALID[fpu-custom] = "Enable Nios2 hardware FPU"
TUNEVALID[fpu-custom-div] = "Enable Nios2 hardware FPU with divider"

# Establish which fpu is configured in TUNE_FEATURES. Soft is the default for gcc.
NIOS2CCARGSFPU_BASIC = "${@bb.utils.contains("TUNE_FEATURES", "fpu-custom", "-mcustom-fpu-cfg=60-1", "", d)}"
NIOS2CCARGSFPU = "${@bb.utils.contains("TUNE_FEATURES", "fpu-custom", "-mcustom-fpu-cfg=60-1", "${NIOS2CCARGSFPU_BASIC}", d)}"

NIOS2PKGFPU_BASIC = "${@bb.utils.contains("TUNE_FEATURES", "fpu-custom", "-fpu", "", d)}"
NIOS2PKGFPU = "${@bb.utils.contains("TUNE_FEATURES", "fpu-custom-div", "-fpudiv", "${NIOS2PKGFPU_BASIC}", d)}"

TUNECONFLICTS[fpu-custom] = "fpu-soft"
TUNECONFLICTS[fpu-custom-div] = "fpu-soft"
```

## conf/machine/include/tune-nios2.inc
```bitbake
#@TYPE: Machine configuration
#@NAME: nios2
DEFAULTTUNE ?= "nios2"
require conf/machine/include/nios2/arch-nios2.inc

TARGET_FPU ?= "soft"
```

## conf/machine/neek.conf
```bitbake
#@TYPE: Machine
#@Name: NEEK example machine
#@DESCRIPTION: Machine configuration for nios2 machines

require conf/machine/include/tune-nios2.inc

TUNE_ARCH = "nios2"
TARGET_FPU = "soft"

#Use sopcinfo and boardinfo file from metadata
SOPCINFO_DIR :="${@os.path.dirname(d.getVar('FILE',True))}/sopcinfo/neek"
SOPCINFO_FILE  := "${SOPCINFO_DIR}/cycloneIII_embedded_evaluation_kit_standard_sopc.sopcinfo"
BOARDINFO_FILE := "${SOPCINFO_DIR}/neek_boardinfo.xml"

MACHINE_FEATURES = "kernel26 serial"

KERNEL_IMAGETYPE = "zImage"

JFFS2_ERASEBLOCK = "0x20000"
```

## conf/machine/nios2custom.conf
```bitbake
#@TYPE: Machine
#@Name: NEEK example machine
#@DESCRIPTION: Machine configuration for nios2 machines

require conf/machine/include/tune-nios2.inc

TUNE_ARCH = "nios2"
TARGET_FPU = "soft"

#Please set these two var's in your local.conf
#SOPCINFO_FILE  = "/absolute/path/to/sopc_or_qsys.sopcinfo"
#BOARDINFO_FILE = "/absolute/path/to/boardinfo.xml"

MACHINE_FEATURES = "kernel26 serial"

KERNEL_IMAGETYPE = "zImage"

#This seems to be commont for NOR-chips on devkits...
JFFS2_ERASEBLOCK ?= "0x20000"
```
